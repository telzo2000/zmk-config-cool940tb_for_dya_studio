## config/boards/shields/cool940tb/Kconfig.shield
```kconfig
config SHIELD_cool940tb_R
    def_bool $(shields_list_contains,cool940tb_R)

config SHIELD_cool940tb_L
    def_bool $(shields_list_contains,cool940tb_L)
```

## config/boards/shields/cool940tb_for_dya_studio/Kconfig.defconfig
```kconfig
if SHIELD_cool940tb_for_dya_studio_R

config ZMK_KEYBOARD_NAME
    default "cool940tb_for_dya_studio_R"

config ZMK_SPLIT
    default y

config ZMK_SPLIT_ROLE_CENTRAL
    default y

endif

if SHIELD_cool940tb_for_dya_studio_L

config ZMK_KEYBOARD_NAME
    default "cool940tb_for_dya_studio_L"

config ZMK_SPLIT
    default y


endif
```

## config/boards/shields/cool940tb_for_dya_studio/Kconfig.shield
```kconfig
config SHIELD_cool940tb_for_dya_studio_R
    def_bool $(shields_list_contains,cool940tb_for_dya_studio_R)

config SHIELD_cool940tb_for_dya_studio_L
    def_bool $(shields_list_contains,cool940tb_for_dya_studio_L)
```
